## meta-rcar-gen3-xen/conf/machine/salvator-x-xen-dom0-thin.conf
```bitbake
require conf/machine/include/salvator-x-xen.inc

KERNEL_DEVICETREE = "renesas/r8a7795-es1-salvator-x-dom0-thin.dtb renesas/r8a7795-es1-salvator-x-dom0-nosd.dtb renesas/domd-3.dtb renesas/domd-0.dtb"
```

## meta-rcar-gen3-xen/conf/machine/salvator-x-xen-dom0.conf
```bitbake
require conf/machine/include/salvator-x-xen.inc

KERNEL_DEVICETREE = "renesas/r8a7795-es1-salvator-x-dom0.dtb"
```
